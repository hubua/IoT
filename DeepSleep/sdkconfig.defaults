## espidf cpp/src/sdkconfig.defaults
```kconfig
#TODO defaults not applied
# https://docs.espressif.com/projects/esp-idf/en/latest/api-guides/build-system.html#custom-sdkconfig-defaults

#
# ESP32-specific
#
CONFIG_IDF_TARGET_ESP32=y
CONFIG_ESP32_REV_MIN_0=n
CONFIG_ESP32_REV_MIN_1=2
CONFIG_ESP32_REV_MIN_2=3
CONFIG_ESP32_REV_MIN_3=4
CONFIG_ESP32_REV_MIN=1

# Reduce bootloader log verbosity
CONFIG_BOOTLOADER_LOG_LEVEL_WARN=y
CONFIG_BOOTLOADER_LOG_LEVEL=2
```
